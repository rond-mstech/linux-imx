// SPDX-License-Identifier: GPL-2.0+
/*
 * Copyright 2019-2022 Variscite Ltd.
 * Updated for MSTECH.
 */
#define MSTECH

#include "imx8qxp-var-som-mst-wifi.dts"
#include "imx8qxp-var-som-mst-m4.dtsi"

/ {
	model = "Variscite VAR-SOM-MX8X on Threatscan Board WIFI M4";
};
