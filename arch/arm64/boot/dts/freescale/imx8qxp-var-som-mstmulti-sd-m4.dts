// SPDX-License-Identifier: GPL-2.0+
/*
 * Copyright 2019-2022 Variscite Ltd.
 */
#define MSTECH
#define MULTI

#include "imx8qxp-var-som-mst-sd.dts"
#include "imx8qxp-var-som-mst-m4.dtsi"

/ {
	model = "Variscite VAR-SOM-MX8X on Threatscan Board SD M4";
};


